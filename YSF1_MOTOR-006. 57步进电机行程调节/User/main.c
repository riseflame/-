/**
  ******************************************************************************
  * 文件名程: main.c 
  * 作    者: 硬石嵌入式开发团队
  * 版    本: V1.0
  * 编写日期: 2015-10-04
  * 功    能: 使用JTAG功能引脚作为普通IO
  ******************************************************************************
  * 说明：
  * 本例程配套硬石stm32开发板YS-F1Pro使用。
  * 
  * 淘宝：
  * 论坛：http://www.ing10bbs.com
  * 版权归硬石嵌入式开发团队所有，请勿商用。
  ******************************************************************************
  */
/* 包含头文件 ----------------------------------------------------------------*/
#include "stm32f10x.h"
#include "bsp/57StepMotor/bsp_TB6600_TIM.h" 
#include "bsp/key/bsp_key.h"
#include "led.h"

/* 私有类型定义 --------------------------------------------------------------*/
/* 私有宏定义 ----------------------------------------------------------------*/
/* 私有变量 ------------------------------------------------------------------*/
uint8_t dir=0; // 0 ：顺时针   1：逆时针 
uint8_t ena=0; // 0 ：正常运行 1：停机

/* 扩展变量 ------------------------------------------------------------------*/
extern __IO uint16_t prescaler; /* 步进电机速度控制，可调节范围为 650 -- 3500 ，值越小速度越快 */

/*
*    当TB6600驱动器细分设置为1时，每200个脉冲步进电机旋转一周
*                          为32时，每6400个脉冲步进电机旋转一周
*    下面以设置为32时为例讲解：
*    pulse_count用于记录输出脉冲数量，pulse_count为脉冲数的两倍，
*    比如当pulse_count=12800时，实际输出6400个完整脉冲。
*    这样可以非常方便步进电机的实际转动圈数，就任意角度都有办法控制输出。
*    如果TB6600驱动器的细分设置为其它值，pulse_count也要做相应处理
*
*/
extern __IO uint32_t pulse_count; /*  脉冲计数，一个完整的脉冲会增加2 */

/* 私有函数原形 --------------------------------------------------------------*/
/* 函数体 --------------------------------------------------------------------*/

/**
  * 函数功能: 主函数.
  * 输入参数: 无
  * 返 回 值: 无
  * 说    明: 无
  */
int main(void)
{  
  uint8_t key1_count=1;
  /* 初始化按键 */
  KEY_GPIO_Init();
  
  /* 初始化定时器PWM输出 */
  TB6600_TIMx_PWM_Init();    
  LED_Init();		  	//初始化与LED连接的硬件接口

  /* 无限循环 */
  while (1)    
  {
    if(KEY1_StateRead()==KEY_DOWN)  // 功能选择
    {
			  LED0=0;          //位带操作

       key1_count++;
       if(key1_count==5)
         key1_count=1;
    }
    if(KEY2_StateRead()==KEY_DOWN)  // 功能调节
    {
      switch(key1_count)
      {
        case 1:
          prescaler-=50;
          if(prescaler<300)  // 最快速度限制
            prescaler=300;
          break;
        case 2:
          prescaler+=100;
          if(prescaler>3500)         // 最慢速度限制
            prescaler=3500;
          break;  
        case 3:                // 方向控制
          if(dir==0)
          {
            GPIO_SetBits(TB6600_DIR_PORT,TB6600_DIR_PIN);  // 逆时针
            dir=1;
          }
          else
          {
            GPIO_ResetBits(TB6600_DIR_PORT,TB6600_DIR_PIN);  // 顺时针
            dir=0;
          }
          break;  
        case 4:                // 使能控制
          if(ena==0)
          {
            GPIO_SetBits(TB6600_ENA_PORT,TB6600_ENA_PIN); // 停机
            ena=1;
          }
          else
          {
            GPIO_ResetBits(TB6600_ENA_PORT,TB6600_ENA_PIN);  // 正常运行
            ena=0;
          }
          break;
        default:
          break;          
      }
    }
    if(pulse_count==12800*1)  // 转动10圈后停机 
    {
      GPIO_SetBits(TB6600_ENA_PORT,TB6600_ENA_PIN); // 停机
    }  
          prescaler-=50;
          if(prescaler<300)  // 最快速度限制
            prescaler=300;    
  }
}

/******************* (C) COPYRIGHT 2015-2020 硬石嵌入式开发团队 *****END OF FILE****/
